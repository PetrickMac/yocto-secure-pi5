## meta-secure-pi5/conf/layer.conf
```bitbake
BBPATH .= ":${LAYERDIR}"
BBFILES += "${LAYERDIR}/recipes-*/*/*.bb ${LAYERDIR}/recipes-*/*/*.bbappend"
BBFILE_COLLECTIONS += "secure-pi5"
BBFILE_PATTERN_secure-pi5 = "^${LAYERDIR}/"
BBFILE_PRIORITY_secure-pi5 = "10"
LAYERDEPENDS_secure-pi5 = "core"
LAYERSERIES_COMPAT_secure-pi5 = "scarthgap"
```
